## conf/bblayers.conf.sample
```bitbake
# LAYER_CONF_VERSION is increased each time build/conf/bblayers.conf
# changes incompatibly
LCONF_VERSION = "7"

SOURCEDIR := "${@os.path.abspath(os.path.dirname(d.getVar('FILE', True)) + '/../../')}"

BBPATH = "${TOPDIR}"
BBFILES ?= ""

BBLAYERS ?= " \
    ${SOURCEDIR}/sources/poky/meta \
    ${SOURCEDIR}/sources/poky/meta-poky \
    ${SOURCEDIR}/sources/meta-openembedded/meta-oe \
    ${SOURCEDIR}/sources/meta-openembedded/meta-multimedia \
    ${SOURCEDIR}/sources/meta-openembedded/meta-networking \
    ${SOURCEDIR}/sources/meta-openembedded/meta-python \
    ${SOURCEDIR}/sources/meta-qt5 \
    ${SOURCEDIR}/sources/meta-raspberrypi \
    ${SOURCEDIR}/sources/meta-rpi3 \
  "
BBLAYERS_NON_REMOVABLE ?= " \
    ${SOURCEDIR}/sources/poky/meta \
"
```

## conf/distro/rpi3.conf
```bitbake
require conf/distro/poky.conf

PREFERRED_VERSION_linux-raspberrypi = "4.9.%"
LICENSE_FLAGS_WHITELIST = "commercial"
DISTRO_FEATURES = "ext2 pam opengl usbhost ${DISTRO_FEATURES_LIBC}"

PREFERRED_PROVIDER_udev = "eudev"
VIRTUAL-RUNTIME_init_manager = "sysvinit"

# Remove Advance Power Management(APM) which is optional for ARM architecture
MACHINE_FEATURES_remove = "apm"


IMAGE_FSTYPES ?= "tar.xz ext3 rpi-sdimg"
```
